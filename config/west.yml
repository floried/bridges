## config/west.yml
```yaml
manifest:
  defaults:
    revision: main
  remotes:
    - name: zmkfirmware
      url-base: https://github.com/zmkfirmware
    - name: Good-Great-Grand-Wonderful
      url-base: https://github.com/Good-Great-Grand-Wonderful
    - name: floried
      url-base: https://github.com/floried
  projects:
    - name: zmk
      remote: zmkfirmware
      revision: ac7f75b8591d39aaf3b66b9d26f26c9ed921a009
      import: app/west.yml
    - name: gggw-zmk-keebs
      remote: Good-Great-Grand-Wonderful
      revision: zephyr-4.1
      import: config/west.yml
    - name: zmk-pmw3610-driver
      remote: floried
      revision: experimenting-pmw3610-no-zaf
  self:
    path: config
```
